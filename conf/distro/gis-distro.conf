## conf/distro/gis-distro.conf
```bitbake
require conf/distro/fsl-imx-xwayland.conf 

DISTRO = "gis-distro"
DISTRO_NAME = "GIS Distro"

# 啟用全域 PipeWire 支援
DISTRO_FEATURES:append = " pipewire usrmerge"
```

## conf/layer.conf
```bitbake
# We have a conf and classes directory, add to BBPATH
BBPATH .= ":${LAYERDIR}"

# We have recipes-* directories, add to BBFILES
BBFILES += "${LAYERDIR}/recipes-*/*/*.bb \
            ${LAYERDIR}/recipes-*/*/*.bbappend"

BBFILE_COLLECTIONS += "meta-gis-frdm-imx93"
BBFILE_PATTERN_meta-gis-frdm-imx93 = "^${LAYERDIR}/"
BBFILE_PRIORITY_meta-gis-frdm-imx93 = "6"

LAYERDEPENDS_meta-gis-frdm-imx93 = "core"
LAYERSERIES_COMPAT_meta-gis-frdm-imx93 = "scarthgap"

QT_GIT = "git://code.qt.io/"
```
